## apps/esp32/switch_example_ble/main/Kconfig.projbuild
```kconfig
menu "Example Configuration"

    choice LED
        prompt "LED type"
        default LED_GPIO if IDF_TARGET_ESP32
        default LED_RMT
        help
            Defines the default peripheral for blink example

        config LED_GPIO
            bool "GPIO"
        config LED_RMT
            bool "RMT - Addressable LED"
    endchoice

    config RMT_TX_CHANNEL
        depends on LED_RMT
        int "RMT Channel"
        range 0 7
        default 0
        help
            Set the RMT peripheral channel.
            ESP32 RMT channel from 0 to 7
            ESP32-S2 RMT channel from 0 to 3
            ESP32-S3 RMT channel from 0 to 3
            ESP32-C3 RMT channel from 0 to 1

    config RMT_TX_GPIO
        int "LED GPIO number"
        range 0 48
        default 8 if IDF_TARGET_ESP32C3 || IDF_TARGET_ESP32H2
        default 18 if IDF_TARGET_ESP32S2
        default 48 if IDF_TARGET_ESP32S3
        default 5
        help
            GPIO number (IOxx) to blink on and off or the RMT signal for the addressable LED.
            Some GPIOs are used for other purposes (flash connections, etc.) and cannot be used to blink.

endmenu
```
